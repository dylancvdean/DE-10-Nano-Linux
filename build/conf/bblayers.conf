## build/conf/bblayers.conf
```bitbake
# POKY_BBLAYERS_CONF_VERSION is increased each time build/conf/bblayers.conf
# changes incompatibly
POKY_BBLAYERS_CONF_VERSION = "2"

BBPATH = "${TOPDIR}"
BBFILES ?= ""

BBLAYERS ?= " \
  /home/dylan/de-10-yocto/DE-10-Nano-Linux/poky/meta \
  /home/dylan/de-10-yocto/DE-10-Nano-Linux/poky/meta-poky \
  /home/dylan/de-10-yocto/DE-10-Nano-Linux/poky/meta-yocto-bsp \
  ${TOPDIR}/../meta-altera \
  "
```
